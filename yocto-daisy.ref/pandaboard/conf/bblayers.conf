## yocto-daisy.ref/pandaboard/conf/bblayers.conf
```bitbake
# LAYER_CONF_VERSION is increased each time build/conf/bblayers.conf
# changes incompatibly
LCONF_VERSION = "6"

BBPATH = "${TOPDIR}"
BBFILES ?= ""

#BBLAYERS ?= " \
#  /home/snikulov/work/yocto/Daisy/poky/meta \
#  /home/snikulov/work/yocto/Daisy/poky/meta-yocto \
#  /home/snikulov/work/yocto/Daisy/poky/meta-yocto-bsp \
#  "
BBLAYERS_NON_REMOVABLE ?= " \
  /home/snikulov/work/yocto/Daisy/poky/meta \
  /home/snikulov/work/yocto/Daisy/poky/meta-yocto \
  "
#added by hob
BBFILES += "${TOPDIR}/recipes/images/custom/*.bb"
#added by hob
BBFILES += "${TOPDIR}/recipes/images/*.bb"

#added by hob
BBLAYERS = "/home/snikulov/work/yocto/Daisy/poky/meta /home/snikulov/work/yocto/Daisy/poky/meta-yocto /home/snikulov/work/yocto/Daisy/poky/meta-yocto-bsp /home/snikulov/work/yocto/Daisy/meta-ti"
```
